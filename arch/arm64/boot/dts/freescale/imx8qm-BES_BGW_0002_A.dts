// SPDX-License-Identifier: GPL-2.0+
/*
 * Copyright 2018 NXP
 *	Dong Aisheng <aisheng.dong@nxp.com>
 */

/dts-v1/;

#include <dt-bindings/usb/pd.h>
#include "imx8qm.dtsi"

/ {
	model = "NXP i.MX8QM BES_BGW_0002_A";
	compatible = "fsl,imx8qm-BES_BGW_0002_A", "fsl,imx8qm";

	chosen {
		stdout-path = &lpuart0;
	};

	memory@80000000 {
		device_type = "memory";
		reg = <0x00000000 0x80000000 0 0x40000000>;
	};

        leds {
                compatible = "gpio-leds";
                pinctrl-names = "default";
                pinctrl-0 = <&pinctrl_led0>;
                pinctrl-1 = <&pinctrl_led1>;
                led0 {
                        label = "led0";
                        gpios = <&lsio_gpio2 14 GPIO_ACTIVE_HIGH>;
                        linux,default-trigger = "heartbeat";
                        default-state = "on";
                };
                led1 {
                        label = "led1";
                        gpios = <&lsio_gpio2 15 GPIO_ACTIVE_HIGH>;
                        default-state = "on";
                };
                cell_led {
                        label = "cell_led";
                        gpios = <&lsio_gpio2 17 GPIO_ACTIVE_HIGH>;
                        default-state = "off";
                };
                wifi_led {
                        label = "wifi_led";
                        gpios = <&lsio_gpio2 19 GPIO_ACTIVE_HIGH>;
                        linux,default-trigger = "mmc2";
                        default-state = "off";
                };
                ble_led {
                        label = "ble_led";
                        gpios = <&lsio_gpio2 20 GPIO_ACTIVE_HIGH>;
                        default-state = "off";
                };
                gps_led {
                        label = "gps_led";
                        gpios = <&lsio_gpio2 18 GPIO_ACTIVE_HIGH>;
                        default-state = "off";
                };

		cell_reset {
			label = "cell_reset";
			gpios = <&lsio_gpio0 9 GPIO_ACTIVE_HIGH>;
			default-state = "off";
		};
        };

//	cell_reset: cell-reset {
//		compatible = "gpio-reset";
//		pinctrl-names = "default", "sleep";
//		pinctrl-0 = <&pinctrl_cell_reset>;
//		reset-gpios = <&lsio_gpio0 9 GPIO_ACTIVE_HIGH>;
//		reset-delay-us = <2000>;
//		reset-post-delay-ms = <40>;
//		#reset-cells = <0>;
//	};
//	gnss_reset: gnss-reset {
//		compatible = "gpio-reset";
//		pinctrl-names = "default", "sleep";
//		pinctrl-0 = <&pinctrl_gnss_reset>;
//		reset-gpios = <&lsio_gpio2 23 GPIO_ACTIVE_LOW>;
//		reset-delay-us = <2000>;
//		reset-post-delay-ms = <40>;
//		#reset-cells = <0>;
//	};

//	cbtl04gp {
//		compatible = "nxp,cbtl04gp";
//		pinctrl-names = "default";
//		pinctrl-0 = <&pinctrl_typec_mux>;
//		switch-gpios = <&lsio_gpio4 6 GPIO_ACTIVE_LOW>;
//		reset-gpios = <&lsio_gpio4 19 GPIO_ACTIVE_HIGH>;
//		orientation-switch;
//
//		port {
//			usb3_data_ss: endpoint {
//				remote-endpoint = <&typec_con_ss>;
//			};
//		};
//	};

	reserved-memory {
		#address-cells = <2>;
		#size-cells = <2>;
		ranges;

		gpu_reserved: gpu_reserved@0x8800000000 {
			no-map;
			reg = <0x8 0x80000000 0 0x10000000>;
		};

		decoder_boot: decoder_boot@0x84000000 {
			no-map;
			reg = <0 0x84000000 0 0x2000000>;
		};
		encoder_boot: encoder_boot@0x86000000 {
			no-map;
			reg = <0 0x86000000 0 0x400000>;
		};
		/*
		 * reserved-memory layout
		 * 0x8800_0000 ~ 0x8FFF_FFFF is reserved for M4
		 * Shouldn't be used at A core and Linux side.
		 *
		 */
		m4_reserved: m4@0x88000000 {
			no-map;
			reg = <0 0x88000000 0 0x8000000>;
		};
		rpmsg_reserved: rpmsg@0x90000000 {
			no-map;
			reg = <0 0x90200000 0 0x200000>;
		};
		decoder_rpc: decoder_rpc@0x92000000 {
			no-map;
			reg = <0 0x92000000 0 0x200000>;
		};
		encoder_rpc: encoder_rpc@0x92200000 {
			no-map;
			reg = <0 0x92200000 0 0x200000>;
		};
		dsp_reserved: dsp@0x92400000 {
			no-map;
			reg = <0 0x92400000 0 0x2000000>;
		};
		encoder_reserved: encoder_reserved@0x94400000 {
			no-map;
			reg = <0 0x94400000 0 0x800000>;
		};

		/* global autoconfigured region for contiguous allocations */
		linux,cma {
			compatible = "shared-dma-pool";
			reusable;
			size = <0 0x3c000000>;
			alloc-ranges = <0 0xc0000000 0 0x3c000000>;
			linux,cma-default;
		};

	};

//	epdev_on: fixedregulator@100 {
//		compatible = "regulator-fixed";
//		pinctrl-names = "default", "sleep";
//		pinctrl-0 = <&pinctrl_wlreg_on>;
//		pinctrl-1 = <&pinctrl_wlreg_on_sleep>;
//		regulator-min-microvolt = <3300000>;
//		regulator-max-microvolt = <3300000>;
//		regulator-name = "epdev_on";
//		gpio = <&lsio_gpio1 13 0>;
//		enable-active-high;
//	};
	
//	reg_usb_otg1_vbus: regulator-usbotg1-vbus {
//		compatible = "regulator-fixed";
//		regulator-name = "usb_otg1_vbus";
//		regulator-min-microvolt = <5000000>;
//		regulator-max-microvolt = <5000000>;
//		gpio = <&lsio_gpio4 3 GPIO_ACTIVE_HIGH>;
//		enable-active-high;
//	};

	reg_usdhc2_vmmc: usdhc2-vmmc {
		compatible = "regulator-fixed";
		regulator-name = "SD1_SPWR";
		regulator-min-microvolt = <3000000>;
		regulator-max-microvolt = <3000000>;
		gpio = <&lsio_gpio4 7 GPIO_ACTIVE_HIGH>;
		off-on-delay-us = <4800>;
		enable-active-high;
	};

	reg_can01_stby: regulator-can01-stby {
		compatible = "regulator-fixed";
		regulator-name = "can01-stby";
		regulator-min-microvolt = <3300000>;
		regulator-max-microvolt = <3300000>;
		gpios = <&lsio_gpio4 02 GPIO_ACTIVE_LOW>;
		enable-active-low;
		regulator-always-on;
	};

	reg_can02_stby: regulator-can2-stby {
		compatible = "regulator-fixed";
		regulator-name = "can02-stby";
		regulator-min-microvolt = <3300000>;
		regulator-max-microvolt = <3300000>;
		gpios = <&lsio_gpio4 01 GPIO_ACTIVE_LOW>;
		enable-active-low;
		regulator-always-on;
	};

	reg_vref_1v8: regulator-adc-vref {
		compatible = "regulator-fixed";
		regulator-name = "vref_1v8";
		regulator-min-microvolt = <1800000>;
		regulator-max-microvolt = <1800000>;
		regulator-always-on;
	};


	reg_wifi_vio: reg_wifi_vio {
		compatible = "regulator-fixed";
		regulator-name = "reg_wifi_vio";
		regulator-min-microvolt = <1800000>;
		regulator-max-microvolt = <1800000>;
		gpios = <&lsio_gpio2 27 GPIO_ACTIVE_HIGH>;
		enable-active-high;
		regulator-always-on;
	};

	reg_wifi_vbat: reg_wifi_vbat {
		compatible = "regulator-fixed";
		regulator-name = "reg_wifi_vbat";
		regulator-min-microvolt = <3300000>;
		regulator-max-microvolt = <3300000>;
		gpios = <&lsio_gpio2 29 GPIO_ACTIVE_HIGH>;
		enable-active-high;
		regulator-always-on;
	};

	reg_wifi_1v8: reg_wifi_1v8 {
		compatible = "regulator-fixed";
		regulator-name = "reg_wifi_1v8";
		regulator-min-microvolt = <1800000>;
		regulator-max-microvolt = <1800000>;
		gpios = <&lsio_gpio2 28 GPIO_ACTIVE_HIGH>;
		enable-active-high;
		regulator-always-on;
		startup-delay-us = <3000>;
	};
	
	reg_wifi_pdn: reg_wifi_pdn {
		compatible = "regulator-fixed";
		regulator-name = "reg_wifi_pdn";
		regulator-min-microvolt = <1800000>;
		regulator-max-microvolt = <1800000>;
		gpios = <&lsio_gpio2 06 GPIO_ACTIVE_HIGH>;
		enable-active-high;
		regulator-always-on;
		startup-delay-us = <5000>;
	};

	/* Cell Power and Reset are INVERTED */
	reg_cell_pwr_on_3v3: reg_cell_pwr_on_3v3 {
		compatible = "regulator-fixed";
		regulator-name = "reg_cell_pwr_on_3v3";
		regulator-min-microvolt = <3300000>;
		regulator-max-microvolt = <3300000>;
		gpios = <&lsio_gpio0 8 GPIO_ACTIVE_HIGH>;
		enable-active-low;
		regulator-always-on;
	};

//	reg_cell_reset: reg_cell_reset {
//		compatible = "regulator-fixed";
//		regulator-name = "reg_cell_reset";
//		regulator-min-microvolt = <3300000>;
//		regulator-max-microvolt = <3300000>;
//		gpios = <&lsio_gpio0 9 GPIO_ACTIVE_HIGH>;
//		enable-active-low;
//		regulator-always-on;
//	};

	/*HDMI Audio cards*/
	sound-hdmi-tx {
		compatible = "fsl,imx-audio-cdnhdmi";
		model = "imx-audio-hdmi-tx";
		audio-cpu = <&sai5>;
		protocol = <1>;
		hdmi-out;
	};

	sound-hdmi-arc {
		compatible = "fsl,imx-audio-spdif";
		model = "imx-hdmi-arc";
		spdif-controller = <&spdif1>;
		spdif-in;
		spdif-out;
	};

	imx8qm_cm40: imx8qm_cm4@0 {
		compatible = "fsl,imx8qm-cm4";
		rsc-da = <0x90000000>;
		mbox-names = "tx", "rx", "rxdb";
		mboxes = <&lsio_mu5 0 1
			  &lsio_mu5 1 1
			  &lsio_mu5 3 1>;
		mub-partition = <3>;
		memory-region = <&vdevbuffer>, <&vdev0vring0>, <&vdev0vring1>,
				<&vdev1vring0>, <&vdev1vring1>, <&rsc_table0>;
		core-index = <0>;
		core-id = <IMX_SC_R_M4_0_PID0>;
		status = "okay";
		power-domains = <&pd IMX_SC_R_M4_0_PID0>,
				<&pd IMX_SC_R_M4_0_MU_1A>;
	};

	imx8qm_cm41: imx8x_cm4@1 {
		compatible = "fsl,imx8qm-cm4";
		rsc-da = <0x90100000>;
		mbox-names = "tx", "rx", "rxdb";
		mboxes = <&lsio_mu6 0 1
			  &lsio_mu6 1 1
			  &lsio_mu6 3 1>;
		mub-partition = <4>;
		memory-region = <&vdevbuffer>, <&vdev2vring0>, <&vdev2vring1>,
				<&vdev3vring0>, <&vdev3vring1>, <&rsc_table1>;
		core-index = <1>;
		core-id = <IMX_SC_R_M4_1_PID0>;
		status = "okay";
		power-domains = <&pd IMX_SC_R_M4_1_PID0>,
				<&pd IMX_SC_R_M4_1_MU_1A>;
	};

	reserved-memory {
		#address-cells = <2>;
		#size-cells = <2>;
		ranges;

		vdev0vring0: vdev0vring0@90000000 {
			reg = <0 0x90000000 0 0x8000>;
			no-map;
		};

		rsc_table0: rsc_table0@90000000 {
			reg = <0 0x90000000 0 0x8000>;
			no-map;
		};

		vdev0vring1: vdev0vring1@90008000 {
			reg = <0 0x90008000 0 0x8000>;
			no-map;
		};

		vdev1vring0: vdev1vring0@90010000 {
			reg = <0 0x90010000 0 0x8000>;
			no-map;
		};

		vdev1vring1: vdev1vring1@90018000 {
			reg = <0 0x90018000 0 0x8000>;
			no-map;
		};

		rsc-table@0 {
			reg = <0 0x900ff000 0 0x1000>;
			no-map;
		};

		vdevbuffer: vdevbuffer {
                        compatible = "shared-dma-pool";
			reg = <0 0x90400000 0 0x100000>;
			no-map;
		};

		vdev2vring0: vdev0vring0@90100000 {
			reg = <0 0x90100000 0 0x8000>;
			no-map;
		};

		rsc_table1: rsc_table1@90100000 {
			reg = <0 0x90100000 0 0x8000>;
			no-map;
		};

		vdev2vring1: vdev0vring1@90108000 {
			reg = <0 0x90108000 0 0x8000>;
			no-map;
		};

		vdev3vring0: vdev1vring0@90110000 {
			reg = <0 0x90110000 0 0x8000>;
			no-map;
		};

		vdev3vring1: vdev1vring1@90118000 {
			reg = <0 0x90118000 0 0x8000>;
			no-map;
		};

		rsc-table@1 {
			reg = <0 0x901ff000 0 0x1000>;
			no-map;
		};
	};
};

&adc0 {
	pinctrl-names = "default";
	vref-supply = <&reg_vref_1v8>;
	status = "okay";
};

&lsio_gpio0{
	pinctrl-names = "default";
	pinctrl-0 = <&pinctrl_gpio0>;
	status = "okay";
};
&lsio_gpio1{
	pinctrl-names = "default";
	pinctrl-0 = <&pinctrl_gpio1>;
	status = "okay";
};
&lsio_gpio2{
	pinctrl-names = "default";
//	pinctrl-0 = <&pinctrl_gpio2>;
	status = "okay";
};
&lsio_gpio3{
	pinctrl-names = "default";
	pinctrl-0 = <&pinctrl_gpio3>;
	status = "okay";
};
&lsio_gpio4{
	pinctrl-names = "default";
	pinctrl-0 = <&pinctrl_gpio4>;
	status = "okay";
};

&dc0_pc {
	status = "okay";
};

&dc0_prg1 {
	status = "okay";
};

&dc0_prg2 {
	status = "okay";
};

&dc0_prg3 {
	status = "okay";
};

&dc0_prg4 {
	status = "okay";
};

&dc0_prg5 {
	status = "okay";
};

&dc0_prg6 {
	status = "okay";
};

&dc0_prg7 {
	status = "okay";
};

&dc0_prg8 {
	status = "okay";
};

&dc0_prg9 {
	status = "okay";
};

&dc0_dpr1_channel1 {
	status = "okay";
};

&dc0_dpr1_channel2 {
	status = "okay";
};

&dc0_dpr1_channel3 {
	status = "okay";
};

&dc0_dpr2_channel1 {
	status = "okay";
};

&dc0_dpr2_channel2 {
	status = "okay";
};

&dc0_dpr2_channel3 {
	status = "okay";
};

&dpu1 {
	status = "okay";
};

&dsp {
	compatible = "fsl,imx8qm-dsp-v1";
	status = "okay";
};

&asrc0 {
	fsl,asrc-rate  = <48000>;
	status = "okay";
};

&amix {
	status = "okay";
};

&esai0 {
	status = "disabled";
};

&sai0{
	status = "disabled";
};

&sai1 {
	status = "disabled";
};

&sai6{
	status = "disabled";
};

&sai7 {
	status = "disabled";
};

&pwm_lvds0{
	status = "disabled";
};

//&i2c1_lvds0{
//	status = "disabled";
//};

&ldb1_phy{
	status = "disabled";
};

&ldb1 {
	status = "disabled";
};

//&i2c0_mipi0 {
//	status = "disabled";
//};
&mipi0_dphy {
	status = "disabled";
};
&mipi0_dsi_host {
	status = "disabled";
};
//&i2c0_mipi1 {
//	status = "disabled";
//};

&mipi1_dphy {
	status = "disabled";
};

&mipi1_dsi_host {
	status = "disabled";
};

&dc1_pc {
	status = "okay";
};

&dc1_prg1 {
	status = "okay";
};

&dc1_prg2 {
	status = "okay";

};

&dc1_prg3 {
	status = "okay";
};

&dc1_prg4 {
	status = "okay";
};

&dc1_prg5 {
	status = "okay";
};

&dc1_prg6 {
	status = "okay";
};

&dc1_prg7 {
	status = "okay";
};

&dc1_prg8 {
	status = "okay";
};

&dc1_prg9 {
	status = "okay";
};

&dc1_dpr1_channel1 {
	status = "okay";
};

&dc1_dpr1_channel2 {
	status = "okay";
};

&dc1_dpr1_channel3 {
	status = "okay";
};

&dc1_dpr2_channel1 {
	status = "okay";
};

&dc1_dpr2_channel2 {
	status = "okay";
};

&dc1_dpr2_channel3 {
	status = "okay";
};

&dpu2 {
	status = "okay";
};

&pwm_lvds1 {
	status = "disabled";
};

/* The nodes shown below have been defined
 * but marked as disabled on the
 * imx8qm-ss-audio.dtsi file.
 */
&sai5 {
	status = "okay";
};

&sai5_lpcg {
	status = "okay";
};

&spdif1 {
	status = "okay";
};

&spdif1_lpcg {
	status = "okay";
};

/* The nodes shown below have been defined
 * but marked as disabled on the
 * imx8qm-ss-hdmi.dtsi file.
 */
&irqsteer_hdmi {
	status = "okay";
};

&hdmi_lpcg_i2c0 {
	status = "okay";
};

&hdmi_lpcg_lis_ipg {
	status = "okay";
};

&hdmi_lpcg_pwm_ipg {
	status = "okay";
};

&hdmi_lpcg_i2s {
	status = "okay";
};

&hdmi_lpcg_gpio_ipg {
	status = "okay";
};

&hdmi_lpcg_msi_hclk {
	status = "okay";
};

&hdmi_lpcg_pxl {
	status = "okay";
};

&hdmi_lpcg_phy {
	status = "okay";
};

&hdmi_lpcg_apb_mux_csr {
	status = "okay";
};

&hdmi_lpcg_apb_mux_ctrl {
	status = "okay";
};

&hdmi_lpcg_apb {
	status = "okay";
};

&hdmi {
	compatible = "cdn,imx8qm-hdmi";
	lane-mapping = <0x93>;
	hdcp-config = <0x3>;
	status = "okay";
};

&ldb2_phy {
	status = "disabled";
};

&ldb2 {
	status = "disabled";
};

&lpspi2 {
	status = "disabled";
};

&emvsim0 {
	status = "disabled";
};

&lpuart0 {
	pinctrl-names = "default";
	pinctrl-0 = <&pinctrl_lpuart0>;
	status = "okay";
};

&lpuart1 { /* TOBY-L200 Cell modem */
	pinctrl-names = "default";
	pinctrl-0 = <&pinctrl_lpuart1>;
//	resets = <&modem_reset>;
	status = "okay";
};

&lpuart2 { /* Dbg console */
	pinctrl-names = "default";
	pinctrl-0 = <&pinctrl_lpuart2>;
	status = "disabled";
};

&lpuart3 { /* Bluetooth */ 
	pinctrl-names = "default";
	pinctrl-0 = <&pinctrl_bt_uart>;
//	fsl,uart-has-rtscts;
	status = "okay";
};

&flexcan1 {
	pinctrl-names = "default";
	pinctrl-0 = <&pinctrl_flexcan1>;
	xceiver-supply = <&reg_can01_stby>;
	status = "okay";
};

&flexcan2 {
	pinctrl-names = "default";
	pinctrl-0 = <&pinctrl_flexcan2>;
	xceiver-supply = <&reg_can02_stby>;
	status = "okay";
};

&flexcan3 {
	status = "disabled";
};

&fec1 {
	status = "disabled";
};

&fec2 {
	status = "disabled";
};

&flexspi0 {
	status = "disabled";
};

&pciea{
	status = "disabled";
};

&pcieb{
	status = "disabled";
};

&rpmsg0{
	/*
	 * 64K for one rpmsg instance:
	 */
	vdev-nums = <2>;
	reg = <0x0 0x90000000 0x0 0x20000>;
	memory-region = <&vdevbuffer>;
	status = "disabled";
};

&rpmsg1{
	/*
	 * 64K for one rpmsg instance:
	 */
	vdev-nums = <2>;
	reg = <0x0 0x90100000 0x0 0x20000>;
	memory-region = <&vdevbuffer>;
	status = "disabled";
};

&sata {
	status = "disabled";
};

&usbphy1 {
	status = "okay";
};

&usbotg1 {
//	vbus-supply = <&reg_cell_reset>;
	pinctrl-names = "default";
//	pinctrl-0 = <&pinctrl_usbotg1>;
	srp-disable;
	hnp-disable;
	adp-disable;
	disable-over-current;
	status = "okay";
//	reset-gpio = <&pinctrl_cell_reset 9 GPIO_ACTIVE_LOW>;
};

&usb3_phy {
	status = "okay";
};

&usbotg3 {
	status = "okay";
};

//&usbotg3_cdns3 {
//	dr_mode = "otg";
//	usb-role-switch;
//	status = "okay";
//
//	port {
//		usb3_drd_sw: endpoint {
//			remote-endpoint = <&typec_dr_sw>;
//		};
//	};
//};

&usdhc1 {
	assigned-clocks = <&clk IMX_SC_R_SDHC_0 IMX_SC_PM_CLK_PER>;
	assigned-clock-rates = <400000000>;
	pinctrl-names = "default", "state_100mhz", "state_200mhz";
	pinctrl-0 = <&pinctrl_usdhc1>;
	pinctrl-1 = <&pinctrl_usdhc1>;
	pinctrl-2 = <&pinctrl_usdhc1>;
	bus-width = <8>;
	no-sd;
	no-sdio;
	non-removable;
	status = "okay";
};

&usdhc2 {
	pinctrl-names = "default", "state_100mhz", "state_200mhz";
	pinctrl-0 = <&pinctrl_usdhc2>, <&pinctrl_usdhc2_gpio>;
	pinctrl-1 = <&pinctrl_usdhc2>, <&pinctrl_usdhc2_gpio>;
	pinctrl-2 = <&pinctrl_usdhc2>, <&pinctrl_usdhc2_gpio>;
	bus-width = <4>;
	vmmc-supply = <&reg_usdhc2_vmmc>;
	cd-gpios = <&lsio_gpio5 22 GPIO_ACTIVE_LOW>;
	wp-gpios = <&lsio_gpio5 21 GPIO_ACTIVE_HIGH>;
	status = "okay";
};

&usdhc3 {
	pinctrl-names = "default", "state_100mhz", "state_200mhz";
	pinctrl-0 = <&pinctrl_usdhc3>, <&pinctrl_usdhc3_gpio>;
	pinctrl-1 = <&pinctrl_usdhc3>, <&pinctrl_usdhc3_gpio>;
	pinctrl-2 = <&pinctrl_usdhc3>, <&pinctrl_usdhc3_gpio>;
	bus-width = <4>;
//	max-frequency = <1000000>;
//      pinctrl-assert-gpios = <&lsio_gpio2 6 GPIO_ACTIVE_LOW>;
//      pinctrl-assert-gpios = <&lsio_gpio2 6 GPIO_ACTIVE_HIGH>;
//	vmmc-supply = <&reg_wifi_pdn>;
	/delete-property/ vmmc-supply;
	/delete-property/ cd-gpios;
	/delete-property/ wp-gpios;
	no-sd;
//	no-mmc;
//	wifi-host;
	pm-ignore-notify;
	keep-power-in-suspend;
	non-removable;
	cap-power-off-card;
//	mcc-pwrseq=<&usdhc3_pwrseq>;
	status = "okay";

//	wifi_wake_host {
//		compatible = "nxp,wifi-wake-host";
//		interrupt-parent  = <&lsio_gpio2>;
//		interrupts = <4 IRQ_TYPE_LEVEL_LOW>;
//		interrupt-names = "host-wake";
//	};

//	wlan: wifi@0 {
//		compatible = "sd8xxx-wlan";
//	};
};

&i2c0 {
	#address-cells = <1>;
	#size-cells = <0>;
	clock-frequency = <400000>;
	pinctrl-names = "default";
	pinctrl-0 = <&pinctrl_i2c0>;
	status = "okay";

	/* U-Blox NEO-M8L GNSS (Does the NEO-M8 driver work for this?) */
//	gnss@42 {
//		compatible = "u-blox,neo-m8";
//		reg = <0x42>; // reg = DDC (i2c) slave address
//		/delete-property/ vcc-supply;
//	};
//	ptn5110: tcpc@51 {
//		compatible = "nxp,ptn5110";
//		pinctrl-names = "default";
//		pinctrl-0 = <&pinctrl_typec>;
//		reg = <0x51>;
//		interrupt-parent = <&lsio_gpio4>;
//		interrupts = <26 IRQ_TYPE_LEVEL_LOW>;
//		status = "okay";
//
//		port {
//			typec_dr_sw: endpoint {
//				remote-endpoint = <&usb3_drd_sw>;
//			};
//		};
//
//		usb_con1: connector {
//			compatible = "usb-c-connector";
//			label = "USB-C";
//			power-role = "source";
//			data-role = "dual";
//			source-pdos = <PDO_FIXED(5000, 3000, PDO_FIXED_USB_COMM)>;
//
//			ports {
//				#address-cells = <1>;
//				#size-cells = <0>;
//
//				port@1 {
//					reg = <1>;
//					typec_con_ss: endpoint {
//						remote-endpoint = <&usb3_data_ss>;
//					};
//				};
//			};
//		};
//	};
};

&i2c4 {
	#address-cells = <1>;
	#size-cells = <0>;
	clock-frequency = <100000>;
	pinctrl-names = "default";
	pinctrl-0 = <&pinctrl_i2c4>;
	status = "okay";
	
	/* The lsm6dsl uses the lsm6dsX driver */
	/* WHO_AM_I is 0x6A */
	/* Read Address = 0xD5 */
	/* Write Address = 0xD4 */
	/* 0xD4 /2 = 0x6A */
	lsm6dsl@6a{
		compatible = "st,lsm6dsl";
		reg = <0x6a>;
		interrupt-parent = <&lsio_gpio4>;
		interrupts = <17 IRQ_TYPE_LEVEL_HIGH>, <18 IRQ_TYPE_LEVEL_HIGH>;
	};
};

&isi_0 {
	status = "okay";

	cap_device {
		status = "okay";
	};

	m2m_device {
		status = "okay";
	};
};

&isi_1 {
	status = "okay";

	cap_device {
		status = "okay";
	};
};

&isi_2 {
	status = "okay";

	cap_device {
		status = "okay";
	};
};

&isi_3 {
	status = "okay";

	cap_device {
		status = "okay";
	};
};

&isi_4 {
	status = "okay";

	cap_device {
		status = "okay";
	};
};

&isi_5 {
	status = "okay";

	cap_device {
		status = "okay";
	};
};

&isi_6 {
	status = "okay";

	cap_device {
		status = "okay";
	};
};

&isi_7 {
	status = "okay";

	cap_device {
		status = "okay";
	};
};

&irqsteer_csi0 {
	status = "okay";
};

&irqsteer_csi1 {
	status = "okay";
};

&mipi_csi_0 {
	status = "disabled";
};

&mipi_csi_1 {
	status = "disabled";
};

&jpegdec {
       status = "okay";
};

&jpegenc {
       status = "okay";
};

&iomuxc {
	pinctrl-names = "default";
//	pinctrl-0 = <&pinctrl_hog>;

// 	pinctrl_hog: hoggrp {
//		fsl,pins = <
//			IMX8QM_ESAI0_SCKR_LSIO_GPIO2_IO24             0x80000000
//			IMX8QM_ESAI0_SCKT_LSIO_GPIO2_IO25             0x80000000
//			IMX8QM_ESAI0_TX0_LSIO_GPIO2_IO26              0x80000000
//		>;
//	};

	// imx8qm_BES_BGW_0002_A
	pinctrl_gpio0: gpio0grp {
		fsl,pins = <
			IMX8QM_GPT0_CAPTURE_LSIO_GPIO0_IO15           0x00000060 /* CELL_DSR_MPU */
			IMX8QM_GPT0_CLK_LSIO_GPIO0_IO14               0x00000060 /* CELL_ON */
			IMX8QM_GPT0_COMPARE_LSIO_GPIO0_IO16           0x00000060 /* CELL_RI_MPU */
			IMX8QM_GPT1_CAPTURE_LSIO_GPIO0_IO18           0x00000060 /* CELL_DTR_MPU */
			IMX8QM_GPT1_CLK_LSIO_GPIO0_IO17               0x00000060 /* CELL_DCD_MPU */
			IMX8QM_GPT1_COMPARE_LSIO_GPIO0_IO19           0x00000060 /* FAN_PWM */
			IMX8QM_M40_GPIO0_00_LSIO_GPIO0_IO08           0x00000060 /* CELL_PWR_ON_3V3 */
			IMX8QM_M40_GPIO0_01_LSIO_GPIO0_IO09           0x00000060 /* CELL_RESET_3V3 */
//			IMX8QM_SCU_GPIO0_00_LSIO_GPIO0_IO28           0x00000063 /* PMIC1_PGOOD */
//			IMX8QM_SCU_GPIO0_01_LSIO_GPIO0_IO29           0x00000063 /* PMIC2_PGOOD */
//			IMX8QM_SCU_GPIO0_02_LSIO_GPIO0_IO30           0x00000063 /* BOOT_LED */
		>;
	};

//	pinctrl_cell_reset: cellresetgrp {
//		fsl,pins = <
//			IMX8QM_M40_GPIO0_01_LSIO_GPIO0_IO09           0x00000060 /* CELL_RESET_3V3 */
//		>;
//	};

	pinctrl_gpio1: gpio1grp {
		fsl,pins = <
			IMX8QM_SCU_GPIO0_04_LSIO_GPIO1_IO00           0x00000063 /* PMIC_ON */
		>;
	};

	pinctrl_led0: led0grp{
		fsl,pins = <
			IMX8QM_SPDIF0_RX_LSIO_GPIO2_IO14              0x00000060
		>;
	};

	pinctrl_led1: led1grp{
		fsl,pins = <
			IMX8QM_SPDIF0_TX_LSIO_GPIO2_IO15              0x00000060
		>;
	};
	
	pinctrl_gpio3: gpio3grp {
		fsl,pins = <
			IMX8QM_MCLK_IN0_LSIO_GPIO3_IO00               0x00000060 /* GPIO_EXT2 */
			IMX8QM_MCLK_OUT0_LSIO_GPIO3_IO01              0x00000060 /* GPIO_EXT3 */
		>;
	};
	pinctrl_gpio4: gpio4grp {
		fsl,pins = <
			IMX8QM_ENET1_MDC_LSIO_GPIO4_IO18              0x00000060 /* IMU_INT2 */
			IMX8QM_ENET1_MDIO_LSIO_GPIO4_IO17             0x00000060 /* IMU_INT1 */
			IMX8QM_USB_SS3_TC1_CONN_USB_OTG2_PWR           0x00000020 /* VUSB2_EN */
		>;
	};

	pinctrl_gnss_reset: gnssresetgrp {
		fsl,pins = <
			IMX8QM_ESAI0_FST_LSIO_GPIO2_IO23              0x00000060
		>;
	};

	pinctrl_gnss_dir: gnssdirgrp {
		fsl,pins = <
			IMX8QM_ESAI0_FSR_LSIO_GPIO2_IO22              0x00000060
		>;
	};

	pinctrl_i2c0: i2c0grp {
		fsl,pins = <
			IMX8QM_HDMI_TX0_TS_SCL_DMA_I2C0_SCL           0x06000020
			IMX8QM_HDMI_TX0_TS_SDA_DMA_I2C0_SDA           0x06000020
		>;
	};

	pinctrl_i2c4: i2c4grp { /* ST IMU */
		fsl,pins = <
			IMX8QM_ENET0_MDC_DMA_I2C4_SCL                 0x06000021
			IMX8QM_ENET0_MDIO_DMA_I2C4_SDA                0x06000021
		>;
	};

	pinctrl_flexcan1: flexcan0grp {
		fsl,pins = <
			IMX8QM_FLEXCAN0_RX_DMA_FLEXCAN0_RX            0x00000021
			IMX8QM_FLEXCAN0_TX_DMA_FLEXCAN0_TX            0x00000021
			IMX8QM_FLEXCAN2_TX_LSIO_GPIO4_IO02            0x06000040
		>;
	};

	pinctrl_flexcan2: flexcan1grp {
		fsl,pins = <
			IMX8QM_FLEXCAN1_RX_DMA_FLEXCAN1_RX            0x00000021
			IMX8QM_FLEXCAN1_TX_DMA_FLEXCAN1_TX            0x00000021
			IMX8QM_FLEXCAN2_RX_LSIO_GPIO4_IO01            0x06000040
		>;
	};

	pinctrl_lpuart0: lpuart0grp {
		fsl,pins = <
			IMX8QM_UART0_RX_DMA_UART0_RX                  0x06000020
			IMX8QM_UART0_TX_DMA_UART0_TX                  0x06000020
		>;
	};

	pinctrl_lpuart1: lpuart1grp {
		fsl,pins = <
			IMX8QM_UART1_CTS_B_DMA_UART1_CTS_B            0x06000020
			IMX8QM_UART1_RTS_B_DMA_UART1_RTS_B            0x06000020
			IMX8QM_UART1_RX_DMA_UART1_RX                  0x06000020
			IMX8QM_UART1_TX_DMA_UART1_TX                  0x06000020
		>;
	};

	pinctrl_lpuart2: lpuart2grp {
		fsl,pins = <
			IMX8QM_UART0_RTS_B_DMA_UART2_RX		0x06000020
			IMX8QM_UART0_CTS_B_DMA_UART2_TX		0x06000020
		>;
	};
        
	pinctrl_bt_uart: bt_uartgrp { /* BLUETOOTH */
		fsl,pins = <
			IMX8QM_ENET0_RGMII_RXD3_DMA_UART3_RX          0x06000060
			IMX8QM_ENET0_RGMII_TXD2_DMA_UART3_TX          0x00000040
//			IMX8QM_ENET0_RGMII_TXD3_DMA_UART3_RTS_B       0x06000060
//			IMX8QM_ENET0_RGMII_RXC_DMA_UART3_CTS_B        0x06000060
		>;
	};

//	pinctrl_typec: typecgrp {
//		fsl,pins = <
//			IMX8QM_QSPI1A_DATA0_LSIO_GPIO4_IO26		0x00000021
//		>;
//	};
//
//	pinctrl_typec_mux: typecmuxgrp {
//		fsl,pins = <
//			IMX8QM_QSPI1A_SS0_B_LSIO_GPIO4_IO19		0x60
//			IMX8QM_USB_SS3_TC3_LSIO_GPIO4_IO06		0x60
//		>;
//	};

	pinctrl_usbotg2: usbotg2 {
		fsl,pins = <
			IMX8QM_USB_SS3_TC1_CONN_USB_OTG2_PWR		0x06000021
		>;
	};

	pinctrl_usdhc1: usdhc1grp {
		fsl,pins = <
			IMX8QM_EMMC0_CLK_CONN_EMMC0_CLK               0x06000041
			IMX8QM_EMMC0_CMD_CONN_EMMC0_CMD               0x00000021
			IMX8QM_EMMC0_DATA0_CONN_EMMC0_DATA0           0x00000021
			IMX8QM_EMMC0_DATA1_CONN_EMMC0_DATA1           0x00000021
			IMX8QM_EMMC0_DATA2_CONN_EMMC0_DATA2           0x00000021
			IMX8QM_EMMC0_DATA3_CONN_EMMC0_DATA3           0x00000021
			IMX8QM_EMMC0_DATA4_CONN_EMMC0_DATA4           0x00000021
			IMX8QM_EMMC0_DATA5_CONN_EMMC0_DATA5           0x00000021
			IMX8QM_EMMC0_DATA6_CONN_EMMC0_DATA6           0x00000021
			IMX8QM_EMMC0_DATA7_CONN_EMMC0_DATA7           0x00000021
			IMX8QM_EMMC0_RESET_B_CONN_EMMC0_RESET_B       0x00000021
			IMX8QM_EMMC0_STROBE_CONN_EMMC0_STROBE         0x00000041
		>;
	};

	pinctrl_usdhc2_gpio: usdhc2grpgpio {
		fsl,pins = <
			IMX8QM_USDHC1_DATA6_LSIO_GPIO5_IO21			0x00000021
			IMX8QM_USDHC1_DATA7_LSIO_GPIO5_IO22			0x00000021
			IMX8QM_USDHC1_RESET_B_LSIO_GPIO4_IO07			0x00000021
		>;
	};

	pinctrl_usdhc2: usdhc2grp {
		fsl,pins = <
			IMX8QM_USDHC1_CLK_CONN_USDHC1_CLK			0x06000041
			IMX8QM_USDHC1_CMD_CONN_USDHC1_CMD			0x00000021
			IMX8QM_USDHC1_DATA0_CONN_USDHC1_DATA0			0x00000021
			IMX8QM_USDHC1_DATA1_CONN_USDHC1_DATA1			0x00000021
			IMX8QM_USDHC1_DATA2_CONN_USDHC1_DATA2			0x00000021
			IMX8QM_USDHC1_DATA3_CONN_USDHC1_DATA3			0x00000021
			IMX8QM_USDHC1_VSELECT_CONN_USDHC1_VSELECT		0x00000021
		>;
	};

	pinctrl_usdhc3: usdhc3grp {
		fsl,pins = <
			IMX8QM_USDHC2_CLK_CONN_USDHC2_CLK			0x06000041
			IMX8QM_USDHC2_CMD_CONN_USDHC2_CMD			0x00000021
			IMX8QM_USDHC2_DATA0_CONN_USDHC2_DATA0			0x00000021
			IMX8QM_USDHC2_DATA1_CONN_USDHC2_DATA1			0x00000021
			IMX8QM_USDHC2_DATA2_CONN_USDHC2_DATA2			0x00000021
			IMX8QM_USDHC2_DATA3_CONN_USDHC2_DATA3			0x00000021
			IMX8QM_USDHC2_VSELECT_CONN_USDHC2_VSELECT		0x00000021
		>;
	};

	pinctrl_usdhc3_gpio: usdhc3gpiogrp {
		fsl,pins = <
			IMX8QM_ESAI0_TX1_LSIO_GPIO2_IO27			0x06000060 /* WIFI VIO EN     - Output */
			IMX8QM_ESAI0_TX2_RX3_LSIO_GPIO2_IO28			0x06000060 /* WIFI_1V8_EN     - Output */ 
			IMX8QM_ESAI0_TX3_RX2_LSIO_GPIO2_IO29			0x06000060 /* WIFI VBAT EN    - Output */
			IMX8QM_ESAI1_SCKR_LSIO_GPIO2_IO06			0x06000060 /* WIFI PDn        - Output */
			IMX8QM_ESAI1_FST_LSIO_GPIO2_IO05			0x06000060 /* WIFI WAKE MPU   - Input  */
			IMX8QM_ESAI1_FSR_LSIO_GPIO2_IO04			0x06000060 /* WIFI SLEEP STAT - Input  */
			IMX8QM_ESAI1_SCKT_LSIO_GPIO2_IO07			0x06000060 /* WIFI PG         - Input  */
			IMX8QM_ESAI1_TX0_LSIO_GPIO2_IO08			0x06000060 /* WIFI VIO PG     - Input  */
			IMX8QM_ESAI1_TX2_RX3_LSIO_GPIO2_IO10			0x06000060 /* WIFI VBATT PG   - Intput */
		>;
	};

};

&thermal_zones {
	pmic-thermal0 {
		polling-delay-passive = <250>;
		polling-delay = <2000>;
		thermal-sensors = <&tsens IMX_SC_R_PMIC_0>;
		trips {
			pmic_alert0: trip0 {
				temperature = <110000>;
				hysteresis = <2000>;
				type = "passive";
			};
			pmic_crit0: trip1 {
				temperature = <125000>;
				hysteresis = <2000>;
				type = "critical";
			};
		};
		cooling-maps {
			map0 {
				trip = <&pmic_alert0>;
				cooling-device =
				<&A53_0 THERMAL_NO_LIMIT THERMAL_NO_LIMIT>,
				<&A53_1 THERMAL_NO_LIMIT THERMAL_NO_LIMIT>,
				<&A53_2 THERMAL_NO_LIMIT THERMAL_NO_LIMIT>,
				<&A53_3 THERMAL_NO_LIMIT THERMAL_NO_LIMIT>,
				<&A72_0 THERMAL_NO_LIMIT THERMAL_NO_LIMIT>,
				<&A72_1 THERMAL_NO_LIMIT THERMAL_NO_LIMIT>;
			};
		};
	};
};

&gpu_3d0{
	status = "okay";
};

&gpu_3d1{
	status = "okay";
};

&imx8_gpu_ss {
	memory-region=<&gpu_reserved>;
	status = "okay";
};

&mu_m0{
	interrupts = <GIC_SPI 472 IRQ_TYPE_LEVEL_HIGH>;
};

&mu1_m0{
	interrupts = <GIC_SPI 473 IRQ_TYPE_LEVEL_HIGH>;
};

&mu2_m0{
	interrupts = <GIC_SPI 474 IRQ_TYPE_LEVEL_HIGH>;
	status = "okay";
};

&vpu_decoder {
	compatible = "nxp,imx8qm-b0-vpudec";
	boot-region = <&decoder_boot>;
	rpc-region = <&decoder_rpc>;
	reg-csr = <0x2d080000>;
	core_type = <2>;
	status = "okay";
};

&vpu_encoder {
	compatible = "nxp,imx8qm-b0-vpuenc";
	boot-region = <&encoder_boot>;
	rpc-region = <&encoder_rpc>;
	reserved-region = <&encoder_reserved>;
	reg-rpc-system = <0x40000000>;
	resolution-max = <1920 1920>;
	fps-max = <120>;
	power-domains = <&pd IMX_SC_R_VPU_ENC_0>, <&pd IMX_SC_R_VPU_ENC_1>,
			<&pd IMX_SC_R_VPU>;
	power-domain-names = "vpuenc1", "vpuenc2", "vpu";
	mbox-names = "enc1_tx0", "enc1_tx1", "enc1_rx",
		     "enc2_tx0", "enc2_tx1", "enc2_rx";
	mboxes = <&mu1_m0 0 0
		  &mu1_m0 0 1
		  &mu1_m0 1 0
		  &mu2_m0 0 0
		  &mu2_m0 0 1
		  &mu2_m0 1 0>;
	status = "okay";

	vpu_enc_core0: core0@1020000 {
		compatible = "fsl,imx8-mu1-vpu-m0";
		reg = <0x1020000 0x20000>;
		reg-csr = <0x1090000 0x10000>;
		interrupts = <GIC_SPI 473 IRQ_TYPE_LEVEL_HIGH>;
		fsl,vpu_ap_mu_id = <17>;
		fw-buf-size = <0x200000>;
		rpc-buf-size = <0x80000>;
		print-buf-size = <0x80000>;
	};

	vpu_enc_core1: core1@1040000 {
		compatible = "fsl,imx8-mu2-vpu-m0";
		reg = <0x1040000 0x20000>;
		reg-csr = <0x10A0000 0x10000>;
		interrupts = <GIC_SPI 474 IRQ_TYPE_LEVEL_HIGH>;
		fsl,vpu_ap_mu_id = <18>;
		fw-buf-size = <0x200000>;
		rpc-buf-size = <0x80000>;
		print-buf-size = <0x80000>;
	};
};
